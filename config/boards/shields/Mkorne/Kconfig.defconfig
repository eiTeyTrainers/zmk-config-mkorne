## config/boards/shields/Mkorne/Kconfig.defconfig
```kconfig
if SHIELD_MKorne_LEFT

config ZMK_KEYBOARD_NAME
    default "MKorne"

config ZMK_SPLIT_ROLE_CENTRAL
    default y

endif

if SHIELD_MKorne_LEFT || SHIELD_MKorne_RIGHT

config ZMK_SPLIT
    default y

endif
```

## config/boards/shields/Mkorne/Kconfig.shield
```kconfig
config SHIELD_MKORNE_LEFT
    def_bool $(shields_list_contains,MKorne_left)

config SHIELD_MKORNE_RIGHT
    def_bool $(shields_list_contains,MKorne_right)
```
